/dts-v1/;
/plugin/;

/ {
    compatible = "brcm,bcm2835";

    fragment@0 {
        target = <&gpio>;
        __overlay__ {
            keybusdev_pins: keybusdev_pins {
                brcm,pins = <23 24>;     /* GPIO numbers */
                brcm,function = <0 0>;   /* 0 = input */
                brcm,pull = <2 2>;       /* 2 = pull-up */
            };
        };
    };

    fragment@1 {
        target-path = "/";
        __overlay__ {
            keybusdev {
                compatible = "keybus,keybusdev";
                pinctrl-names = "default";
                pinctrl-0 = <&keybusdev_pins>;
            };
        };
    };
};
